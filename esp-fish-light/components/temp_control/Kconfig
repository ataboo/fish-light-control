## esp-fish-light/components/temp_control/Kconfig
```kconfig
menu "Temp Control"
    config TEMP_COUNT
        int "Temp Count"
        default 1
        range 0 4
        help
            Number of DS18B20 temp sensors.

    config TEMP_0_NAME
        string "Temp 0 Name"
        default "Temp 0"

    config TEMP_0_ID
        string "Temp 0 OWB ID"
        default ""

    config TEMP_1_NAME
        string "Temp 1 Name"
        default "Temp 1"

    config TEMP_1_ID
        string "Temp 1 OWB ID"
        default ""

    config TEMP_2_NAME
        string "Temp 2 Name"
        default "Temp 2"

    config TEMP_2_ID
        string "Temp 2 OWB ID"
        default ""

    config TEMP_3_NAME
        string "Temp 3 Name"
        default "Temp 3"

    config TEMP_3_ID
        string "Temp 3 OWB ID"
        default ""

endmenu
```

## esp-fish-light/main/Kconfig.projbuild
```kconfig
menu "ESP-Fish-Light"
    config WIFI_SSID
        string "WiFi SSID"
        default "myssid"
        help
            SSID (network name).

    config WIFI_PASSWORD
        string "WiFi Password"
        default "mypassword"
        help
            WiFi password.

    config LIGHTSTRIP_GPIO
        int "Lightstrip GPIO Pin"
        default 17
        range 0 36
        help
            GPIO number for the lightstrip.

    config LED_COUNT
        int "LED Count"
        default 10
        help
            Number of LEDs in lightstrip.

    config TIMEZONE
        string "Timezone"
        default "PST8PDT,M3.2.0/2,M11.1.0"
        help
            Timezone for light dimming.

    config MIDDAY_COLOR
        hex "Mid day color"
        default 0x946420
        help
            Color value at full brightness.

    config SUNRISE_START
        int "Sunrise Start"
        default 800
        help
            Start of sunrise transition {h}{M}

    config SUNRISE_END
        int "Sunrise End"
        default 1000
        help
            End of sunrise transition {h}{M}

    config SUNSET_START
        int "Sunset Start"
        default 1800
        help
            Start of sunset transition {h}{M}

    config SUNSET_END
        int "Sunset End"
        default 2000
        help
            End of sunset transition {h}{M}
endmenu
```
